AUTOSAR XML (schema 00050)
package /ARRoot
  can cluster CoilLeftCanCluster
    can physical channel CoilLeftCanPhysicalChannel: comm-connectors=CoilLeftCanCommunicationConnector
  ecu instance CoilLeftEcuInstance
    can communication controller CoilLeftCanCommunicationController
    can communication connector CoilLeftCanCommunicationConnector: comm-controller=CoilLeftCanCommunicationController
  flat map CoilLeftFlatMap: instances=flat-instance-descriptor=CoilLeftSystem.CoilServerOP
  system CoilLeftSystem
    system mapping CoilLeftSofwareMapping: client-server-to-signal-mapping=communication-direction=OUT
      sw-impl-mappings:
        swc to impl mapping CoilLeftSwcToImplMapping: component-implementation=CoilTypeImplFile, component=CoilLeftRootSoftwareComposition.CoilLeftSwComponentProto.CoilLeftSwComponentProto
      sw-mappings:
        swc to ecu mapping CoilLeftSwcToEcuMapping: component=CoilLeftRootSoftwareComposition.CoilLeftSwComponentProto.CoilLeftSwComponentProto, controlled-hw-element=/ARRoot/, ecu-instance=CoilLeftEcuInstance, processing-unit=/ARRoot/
    root-software-compositions:
      root sw composition prototype CoilLeftRootSoftwareComposition: flat-map=CoilLeftFlatMap, software-composition=CoilLeftTopLevelComposition
  composition sw component type CoilLeftTopLevelComposition
    component CoilLeftSwComponentProto
    delegation sw connector CoilLeftConnectorProto: outer-port=CoilServerOP
  can cluster CoilRightCanCluster
    can physical channel CoilRightCanPhysicalChannel: comm-connectors=CoilRightCanCommunicationConnector
  ecu instance CoilRightEcuInstance
    can communication controller CoilRightCanCommunicationController
    can communication connector CoilRightCanCommunicationConnector: comm-controller=CoilRightCanCommunicationController
  flat map CoilRightFlatMap: instances=flat-instance-descriptor=CoilRightSystem.CoilServerOP
  system CoilRightSystem
    system mapping CoilRightSofwareMapping: client-server-to-signal-mapping=communication-direction=IN
      sw-impl-mappings:
        swc to impl mapping CoilRightSwcToImplMapping: component-implementation=CoilTypeImplFile, component=CoilRightRootSoftwareComposition.CoilRightSwComponentProto.CoilRightSwComponentProto
      sw-mappings:
        swc to ecu mapping CoilRightSwcToEcuMapping: component=CoilRightRootSoftwareComposition.CoilRightSwComponentProto.CoilRightSwComponentProto, controlled-hw-element=/ARRoot/, ecu-instance=CoilRightEcuInstance, processing-unit=/ARRoot/
    root-software-compositions:
      root sw composition prototype CoilRightRootSoftwareComposition: flat-map=CoilRightFlatMap, software-composition=CoilRightTopLevelComposition
  composition sw component type CoilRightTopLevelComposition
    component CoilRightSwComponentProto
    delegation sw connector CoilRightConnectorProto: outer-port=CoilServerOP
  can cluster LedDialLeftCanCluster
    can physical channel LedDialLeftCanPhysicalChannel: comm-connectors=LedDialLeftCanCommunicationConnector
  ecu instance LedDialLeftEcuInstance
    can communication controller LedDialLeftCanCommunicationController
    can communication connector LedDialLeftCanCommunicationConnector: comm-controller=LedDialLeftCanCommunicationController
  flat map LedDialLeftFlatMap: instances=flat-instance-descriptor=LedDialLeftSystem.DialLedLeft
  system LedDialLeftSystem
    system mapping LedDialLeftSoftwareMapping: sender-receiver-to-signal-mapping=communication-direction=IN
      sw-impl-mappings:
        swc to impl mapping LedDialLeftSwcToImplMapping: component-implementation=LedDialImplFile, component=LedDialLeftRootSoftwareComposition.LedDialLeftSwComponentProto.LedDialLeftSwComponentProto
      sw-mappings:
        swc to ecu mapping LedDialLeftSwcToEcuMapping: component=LedDialLeftRootSoftwareComposition.LedDialLeftSwComponentProto.LedDialLeftSwComponentProto, controlled-hw-element=/ARRoot/, ecu-instance=LedDialLeftEcuInstance, processing-unit=/ARRoot/
    root-software-compositions:
      root sw composition prototype LedDialLeftRootSoftwareComposition: flat-map=LedDialLeftFlatMap, software-composition=LedDialLeftTopLevelComposition
  composition sw component type LedDialLeftTopLevelComposition
    component LedDialLeftSwComponentProto
    assembly sw connector LedDialLeftConnectorProto
  can cluster LedDialRightCanCluster
    can physical channel LedDialRightCanPhysicalChannel: comm-connectors=LedDialRightCanCommunicationConnector
  ecu instance LedDialRightEcuInstance
    can communication controller LedDialRightCanCommunicationController
    can communication connector LedDialRightCanCommunicationConnector: comm-controller=LedDialRightCanCommunicationController
  flat map LedDialRightFlatMap: instances=flat-instance-descriptor=LedDialRightSystem.DialLedRight
  system LedDialRightSystem
    system mapping LedDialRightSoftwareMapping: sender-receiver-to-signal-mapping=communication-direction=IN
      sw-impl-mappings:
        swc to impl mapping LedDialRightSwcToImplMapping: component-implementation=LedDialImplFile, component=LedDialRightRootSoftwareComposition.LedDialLeftSwComponentProto.LedDialLeftSwComponentProto
      sw-mappings:
        swc to ecu mapping LedDialRightSwcToEcuMapping: component=LedDialRightRootSoftwareComposition.LedDialLeftSwComponentProto.LedDialLeftSwComponentProto, controlled-hw-element=/ARRoot/, ecu-instance=LedDialRightEcuInstance, processing-unit=/ARRoot/
    root-software-compositions:
      root sw composition prototype LedDialRightRootSoftwareComposition: flat-map=LedDialRightFlatMap, software-composition=LedDialRightTopLevelComposition
  composition sw component type LedDialRightTopLevelComposition
    component LedDialRightSwComponentProto
    assembly sw connector LedDialRightConnectorProto
  can cluster SeatHeatingLeftCanCluster
    can physical channel SeatHeatingLeftCanPhysicalChannel: comm-connectors=SeatHeatingLeftCanCommunicationConnector
  ecu instance SeatHeatingLeftEcuInstance
    can communication controller SeatHeatingLeftCanCommunicationController
    can communication connector SeatHeatingLeftCanCommunicationConnector: comm-controller=SeatHeatingLeftCanCommunicationController
  system SeatHeatingLeftSystem
    system mapping SeatHeatingLeftSoftwareMapping
      data-mappings:
        client-server-to-signal-mapping=communication-direction=OUT
        sender-receiver-to-signal-mapping=communication-direction=OUT
        sender-receiver-to-signal-mapping=communication-direction=IN
      sw-impl-mappings:
        swc to impl mapping SeatHeatingLeftSwcToImplMapping: component-implementation=HeatingElementImplFile, component=SeatHeatingLeftRootSoftwareComposition.SeatHeatingLeftSwComponentProto.SeatHeatingLeftSwComponentProto
      sw-mappings:
        swc to ecu mapping SeatHeatingLeftSwcToEcuMapping: component=SeatHeatingLeftRootSoftwareComposition.SeatHeatingLeftSwComponentProto.SeatHeatingLeftSwComponentProto, controlled-hw-element=/ARRoot/, ecu-instance=SeatHeatingLeftEcuInstance, processing-unit=/ARRoot/
    root-software-compositions:
      root sw composition prototype SeatHeatingLeftRootSoftwareComposition: flat-map=SeatingHeatingLeftFlatMap, software-composition=SeatHeatingLeftTopLevelComposition
  composition sw component type SeatHeatingLeftTopLevelComposition
    component SeatHeatingLeftSwComponentProto
    delegation sw connector SeatHeatingLeftConnectorProto: outer-port=HeatingElementLeft
    assembly sw connector SeatHeatingLeftConnectorProto
  can cluster SeatHeatingRightCanCluster
    can physical channel SeatHeatingRightCanPhysicalChannel: comm-connectors=SeatHeatingRightCanCommunicationConnector
  ecu instance SeatHeatingRightEcuInstance
    can communication controller SeatHeatingRightCanCommunicationController
    can communication connector SeatHeatingRightCanCommunicationConnector: comm-controller=SeatHeatingRightCanCommunicationController
  system SeatHeatingRightSystem
    system mapping SeatHeatingRightSoftwareMapping
      data-mappings:
        client-server-to-signal-mapping=communication-direction=OUT
        sender-receiver-to-signal-mapping=communication-direction=OUT
        sender-receiver-to-signal-mapping=communication-direction=IN
      sw-impl-mappings:
        swc to impl mapping SeatHeatingRightSwcToImplMapping: component-implementation=HeatingElementImplFile, component=SeatHeatingRightRootSoftwareComposition.SeatHeatingRightSwComponentProto.SeatHeatingRightSwComponentProto
      sw-mappings:
        swc to ecu mapping SeatHeatingRightSwcToEcuMapping: component=SeatHeatingRightRootSoftwareComposition.SeatHeatingRightSwComponentProto.SeatHeatingRightSwComponentProto, controlled-hw-element=/ARRoot/, ecu-instance=SeatHeatingRightEcuInstance, processing-unit=/ARRoot/
    root-software-compositions:
      root sw composition prototype SeatHeatingRightRootSoftwareComposition: flat-map=SeatingHeatingRightFlatMap, software-composition=SeatHeatingRightTopLevelComposition
  composition sw component type SeatHeatingRightTopLevelComposition
    component SeatHeatingRightSwComponentProto
    delegation sw connector SeatHeatingRightConnectorProto: outer-port=HeatingElementRight
    assembly sw connector SeatHeatingRightConnectorProto
  flat map SeatingHeatingLeftFlatMap: instances=flat-instance-descriptor=SeatHeatingLeftSystem.HeatingElementLeft
  flat map SeatingHeatingRightFlatMap: instances=flat-instance-descriptor=SeatHeatingRightSystem.HeatingElementRight
