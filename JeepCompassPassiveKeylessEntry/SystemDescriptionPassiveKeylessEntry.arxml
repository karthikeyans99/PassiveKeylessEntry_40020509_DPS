AUTOSAR XML (schema 00050)
package /ARRoot
  can cluster PassiveKeylessEntryLeftCanCluster
    can physical channel PassiveKeylessEntryLeftCanPhysicalChannel: comm-connectors=PassiveKeylessEntryLeftCanCommunicationConnector
  ecu instance PassiveKeylessEntryLeftECUInstance
    can communication controller PassiveKeylessEntryLeftCanCommunicationController
    can communication connector PassiveKeylessEntryLeftCanCommunicationConnector: comm-controller=PassiveKeylessEntryLeftCanCommunicationController
  flat map PassiveKeylessEntryLeftFlatMap: instances=flat-instance-descriptor=PassiveKeylessEntryLeftSystem.PassiveKeylessEntryLeftRootSoftwareComposition.PassiveKeylessEntryLeft
  system PassiveKeylessEntryLeftSystem
    system mapping PassiveKeylessEntryLeftSoftwareMapping: client-server-to-signal-mapping=communication-direction=OUT
      sw-impl-mappings:
        swc to impl mapping PassiveKeylessEntryLeftSwcToImpleMapping: component-implementation=PassiveKeylessEntryImp, component=PassiveKeylessEntryLeftRootSoftwareComposition.PassiveKeylessEntryLeftSwComponentProto.PassiveKeylessEntryLeftSwComponentProto
      sw-mappings:
        swc to ecu mapping PassiveKeylessEntryLeftSwcToEcuMapping: component=PassiveKeylessEntryLeftRootSoftwareComposition.PassiveKeylessEntryLeftSwComponentProto.PassiveKeylessEntryLeftSwComponentProto, controlled-hw-element=/ARRoot/, ecu-instance=PassiveKeylessEntryLeftECUInstance, processing-unit=/ARRoot/
    root-software-compositions:
      root sw composition prototype PassiveKeylessEntryLeftRootSoftwareComposition: flat-map=PassiveKeylessEntryLeftFlatMap, software-composition=PassiveKeylessEntryLeftTopLevelComposition
  composition sw component type PassiveKeylessEntryLeftTopLevelComposition
    component PassiveKeylessEntryLeftSwComponentProto: type=PassiveKeylessEntryControllerType
    delegation sw connector PassiveKeylessEntryLeftConnectorProto: outer-port=PassiveKeylessEntryLeft
  can cluster PassiveKeylessEntryRightCanCluster
    can physical channel PassiveKeylessEntryRightCanPhysicalChannel: comm-connectors=PassiveKeylessEntryRightCanCommunicationConnector
  ecu instance PassiveKeylessEntryRightECUInstance
    can communication controller PassiveKeylessEntryRightCanCommunicationController
    can communication connector PassiveKeylessEntryRightCanCommunicationConnector: comm-controller=PassiveKeylessEntryRightCanCommunicationController
  flat map PassiveKeylessEntryRightFlatMap: instances=flat-instance-descriptor=PassiveKeylessEntryRightSystem.PassiveKeylessEntryRightRootSoftwareComposition.PassiveKeylessEntryRight
  system PassiveKeylessEntryRightSystem
    system mapping PassiveKeylessEntryRightSoftwareMapping: client-server-to-signal-mapping=communication-direction=OUT
      sw-impl-mappings:
        swc to impl mapping PassiveKeylessEntryRightSwcToImpleMapping: component-implementation=PassiveKeylessEntryImp, component=PassiveKeylessEntryRightRootSoftwareComposition.PassiveKeylessEntryRightSwComponentProto.PassiveKeylessEntryRightSwComponentProto
      sw-mappings:
        swc to ecu mapping PassiveKeylessEntryRightSwcToEcuMapping: component=PassiveKeylessEntryRightRootSoftwareComposition.PassiveKeylessEntryRightSwComponentProto.PassiveKeylessEntryRightSwComponentProto, controlled-hw-element=/ARRoot/, ecu-instance=PassiveKeylessEntryRightECUInstance, processing-unit=/ARRoot/
    root-software-compositions:
      root sw composition prototype PassiveKeylessEntryRightRootSoftwareComposition: flat-map=PassiveKeylessEntryRightFlatMap, software-composition=PassiveKeylessEntryRightTopLevelComposition
  composition sw component type PassiveKeylessEntryRightTopLevelComposition
    component PassiveKeylessEntryRightSwComponentProto: type=PassiveKeylessEntryControllerType
    delegation sw connector PassiveKeylessEntryRightConnectorProto: outer-port=PassiveKeylessEntryRight
